## boards/shields/ft_dongle_test/Kconfig.defconfig
```kconfig
if SHIELD_FT_DONGLE_TEST

config ZMK_KEYBOARD_NAME
    default "FT Dongle Test"

# Aktywujemy PWM driver
config PWM
    default y

# Aktywujemy LED driver (pwm-leds)
config LED
    default y

# Wymagane przez Zephyr dla sterowania urządzeniami z device drivers
config DEVICE_DEPS
    default y

endif
```

## boards/shields/ft_dongle_test/Kconfig.shield
```kconfig
config SHIELD_FT_DONGLE_TEST
    def_bool $(shields_list_contains,ft_dongle_test)
```
